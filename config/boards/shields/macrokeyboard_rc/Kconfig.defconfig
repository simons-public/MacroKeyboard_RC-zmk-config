## config/boards/shields/macrokeyboard_rc/Kconfig.defconfig
```kconfig
if SHIELD_MACROKEYBOARD_RC

config ZMK_KEYBOARD_NAME
  default "MacroKeyboard_RC"

config SPI
  default y



endif
```

## config/boards/shields/macrokeyboard_rc/Kconfig.shield
```kconfig
config SHIELD_MACROKEYBOARD_RC
  def_bool $(shields_list_contains,macrokeyboard_rc)
```
